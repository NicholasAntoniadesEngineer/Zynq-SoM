// Python reference corpus generated by temporary execution of
// HEAD:schgen/generate/devicetree.py. No Python is used by this test. Compare
// complete bytes after ONLY the three documented native provenance changes.
// Run: devicetree_contracts DATA_DIR [REPO_ROOT]. No KiCad process is needed:
// the optional project tests reuse the separately verified real live snapshot.
#include "schgen/devicetree.hpp"
#include "schgen/json.hpp"

#include <algorithm>
#include <cstdlib>
#include <filesystem>
#include <fstream>
#include <functional>
#include <iostream>
#include <iterator>
#include <optional>
#include <stdexcept>
#include <string>
#include <vector>
#include <unistd.h>

namespace {
namespace fs = std::filesystem;
using namespace schgen;

void require(bool value, const std::string& message) {
    if (!value) throw std::runtime_error(message);
}
std::string read(const fs::path& path) {
    std::ifstream in(path, std::ios::binary);
    require(bool(in), "cannot read " + path.string());
    return {std::istreambuf_iterator<char>(in), {}};
}
void write(const fs::path& path, const std::string& text) {
    std::ofstream out(path, std::ios::binary);
    out << text; out.close();
    require(bool(out), "cannot write " + path.string());
}
struct TempDir {
    fs::path path;
    TempDir() {
        auto pattern = (fs::temp_directory_path() / "devicetree-contracts-XXXXXX").string();
        require(::mkdtemp(pattern.data()) != nullptr, "mkdtemp failed");
        path = pattern;
    }
    ~TempDir() { std::error_code ec; fs::remove_all(path, ec); }
};
const JsonNode& field(const JsonNode& node, const std::string& key) {
    const auto* value = object_field(node, key);
    require(value != nullptr, "fixture missing " + key);
    return *value;
}
std::string str(const JsonNode& node, const std::string& key) { return field(node, key).string_value; }
XdcStrings pairs(const JsonNode& node) {
    XdcStrings result;
    for (const auto& [key, value] : node.object_value) result.emplace_back(key, value.string_value);
    return result;
}
SomZynq live_from(const JsonNode& node) {
    SomZynq out;
    out.source = str(node,"source"); out.zynq_ref = str(node,"zynq_ref");
    const auto& value=field(node,"value");
    out.value = value.kind==JsonKind::Null ? std::nullopt : std::optional<std::string>{value.string_value};
    out.pin_names=pairs(field(node,"pin_names"));
    out.ball_net=pairs(field(node,"ball_net"));
    out.jpin_net=pairs(field(node,"jpin_net"));
    return out;
}
DeviceTreeInput input_from(const JsonNode& node) {
    DeviceTreeInput in;
    const auto& contract=field(node,"contract");
    in.contract.source=str(contract,"source");
    for(const auto& [ref,data]:field(contract,"connectors").object_value) {
        SomConnector conn;
        conn.pins=pairs(field(data,"pins"));
        in.contract.connectors.emplace_back(ref,std::move(conn));
    }
    in.live=live_from(field(node,"live"));
    in.function_map=pairs(field(node,"function_map"));
    in.refs.clear();
    for(const auto& ref:field(node,"refs").array_value)in.refs.push_back(ref.string_value);
    in.contract_path=str(node,"contract_path");in.contract_source=str(node,"contract_source");
    in.som_source=str(node,"som_source");in.mapping_source=str(node,"mapping_source");
    return in;
}
std::string changed(std::string text,const std::string& before,const std::string& after) {
    const auto p=text.find(before);
    require(p!=std::string::npos && text.find(before,p+before.size())==std::string::npos,
            "baseline provenance target missing or repeated: "+before);
    text.replace(p,before.size(),after);return text;
}
std::string native_expected(std::string text,const std::string& mapping) {
    text=changed(text,"schgen devicetree (schgen/devicetree.py)","schgen devicetree (native/src/devicetree.cpp)");
    text=changed(text,"PYTHONPATH=. python -m schgen devicetree","native/bin/schgen devicetree");
    text=changed(text,"carrier/som_conn_gen FUNCTION_MAP",mapping+" function_map + pudc_straps");
    return text;
}
void same_text(const std::string& actual,const std::string& expected) {
    if(actual==expected)return;
    const auto mismatch=std::mismatch(actual.begin(),actual.end(),expected.begin(),expected.end());
    const auto pos=static_cast<std::size_t>(mismatch.first-actual.begin());
    throw std::runtime_error("DTS bytes differ at "+std::to_string(pos)+": actual "+actual.substr(pos,100)+
                             "; expected "+expected.substr(pos,100));
}
struct Suite {
    int count=0;
    void run(const std::string& label,const std::function<void()>& action) {
        try {action();++count;}catch(const std::exception& e){throw std::runtime_error(label+": "+e.what());}
    }
};

void contracts(const fs::path& fixtures,const std::optional<fs::path>& repo) {
    Suite s;
    const auto cases=parse_json_file((fixtures/"devicetree_cases.json").string());
    for(const auto& row:cases.array_value) {
        s.run(str(row,"name"),[&] {
            const auto in=input_from(field(row,"input"));
            const auto* expected_error=object_field(row,"error");
            try {
                const auto out=generate_devicetree(in);
                require(!expected_error,"expected failure was accepted");
                same_text(out.text,native_expected(str(row,"text"),in.mapping_source));
                require(out.sdio_rows.size()==6,"SDIO population changed");
                std::size_t n_mio=0,pos=0;
                while((pos=out.text.find("/* MIO",pos))!=std::string::npos){++n_mio;pos+=6;}
                require(n_mio==out.mio_rows.size(),"MIO report count differs from emitted rows");
            } catch(const DeviceTreeError& e) {
                require(expected_error && e.what()==expected_error->string_value,
                        "wrong failure: "+std::string(e.what()));
            }
        });
    }
    auto in=input_from(field(cases.array_value.front(),"input"));
    s.run("typed row ordering, numeric pins and PS classification",[&] {
        const auto out=generate_devicetree(in);
        require(out.mio_rows.size()==4,"MIO population changed");
        require(out.mio_rows[0].index=="2" && out.mio_rows[1].index=="8" && out.mio_rows[2].index=="10",
                "MIO rows sorted lexically");
        require(out.sdio_rows[0].jpin=="J1.2","did not choose lowest numeric pin on first lexical ref");
        require(out.mio_rows[2].function=="ZYNQ_PS_UART0_RXD","MIO mapping changed");
        require(out.text.find(" * &uart0 {")!=std::string::npos && out.text.find(" * &sdhci0 {")!=std::string::npos,
                "commented overlay templates disappeared");
    });

    TempDir temp;
    const auto project=temp.path/"project";
    fs::create_directory(project);
    const auto contract=project/"som_interface.json";
    const auto mapping=project/"som_mapping.json";
    write(contract,som_interface_json(in.contract));
    const std::string valid=R"({"schema":"schgen.som_mapping.v1","function_map":{"ZYNQ_PS_MIO10":"ignored","ZYNQ_PS_MIO11":"ZYNQ_PS_UART0_TXD"},"pudc_straps":{"ZYNQ_PS_MIO10":"ZYNQ_PS_UART0_RXD","strap":"renamed"},"vcco_rail_map":{},"rebound_som_rails":{},"isolated_som_rails":{},"do_not_load_straps":[]})";
    write(mapping,valid);
    s.run("JSON function mapping overlay retains insertion order",[&] {
        auto live=in.live;live.source=(temp.path/"not-a-schematic.kicad_sch").string();
        const auto loaded=load_devicetree_input(temp.path,project,live);
        require(loaded.function_map==XdcStrings{{"ZYNQ_PS_MIO10","ZYNQ_PS_UART0_RXD"},
            {"ZYNQ_PS_MIO11","ZYNQ_PS_UART0_TXD"},{"strap","renamed"}},"pudc override/order changed");
        require(loaded.mapping_source=="project/som_mapping.json" && loaded.contract_source=="project/som_interface.json",
                "repository-relative sources changed");
        require(loaded.som_source=="not-a-schematic.kicad_sch","source path changed");
        require(generate_devicetree(loaded).mio_rows.size()==4,"loader did not reuse provided live extraction");
    });
    s.run("explicit contract and refs",[&] {
        const auto override=temp.path/"alternate.json";
        write(override,som_interface_json(in.contract));
        const auto loaded=load_devicetree_input(temp.path,project,in.live,override,{"J1"});
        require(loaded.refs==std::vector<std::string>{"J1"} && loaded.contract_path==override.string(),
                "explicit selection lost");
        require(generate_devicetree(loaded).mio_rows.size()==4,"selected connector walk failed");
    });
    for(const auto& [label,bad]:XdcStrings{
            {"missing schema",R"({"function_map":{},"pudc_straps":{}})"},
            {"unsupported schema",R"({"schema":"wrong","function_map":{},"pudc_straps":{}})"},
            {"missing function_map",R"({"schema":"schgen.som_mapping.v1","pudc_straps":{}})"},
            {"bad function_map",R"({"schema":"schgen.som_mapping.v1","function_map":[],"pudc_straps":{}})"},
            {"missing pudc_straps",R"({"schema":"schgen.som_mapping.v1","function_map":{}})"},
            {"invalid mapping type",R"({"schema":"schgen.som_mapping.v1","function_map":{"a":1},"pudc_straps":{}})"},
            {"empty mapping key",R"({"schema":"schgen.som_mapping.v1","function_map":{"":"b"},"pudc_straps":{}})"},
            {"empty mapping value",R"({"schema":"schgen.som_mapping.v1","function_map":{},"pudc_straps":{"a":""}})"}}) {
        s.run(label,[&, invalid = bad] {
            write(mapping,invalid);
            try {load_devicetree_input(temp.path,project,in.live);}
            catch(const DeviceTreeError& e){require(std::string(e.what()).find(mapping.string())!=std::string::npos,
                "mapping failure lost source path");return;}
            throw std::runtime_error("invalid mapping accepted");
        });
    }
    for(const auto* policy:{"function_map","pudc_straps","vcco_rail_map","rebound_som_rails"}) {
        s.run(std::string("protected boot strap in ")+policy,[&] {
            auto bad=changed(valid,"\"do_not_load_straps\":[]","\"do_not_load_straps\":[\"BOOT\"]");
            bad=changed(bad,std::string("\"")+policy+"\":{",std::string("\"")+policy+"\":{\"BOOT\":\"loaded\",");
            // Empty objects need no trailing comma before the closing brace.
            const auto empty=bad.find("\"loaded\",}");
            if(empty!=std::string::npos)bad.erase(empty+8,1);
            write(mapping,bad);
            try {load_devicetree_input(temp.path,project,in.live);}
            catch(const DeviceTreeError& e){
                const std::string message=e.what();
                require(message.find("BOOT")!=std::string::npos && message.find("strap")!=std::string::npos,
                        "protected strap gate did not explain conflict: "+message);
                return;
            }
            throw std::runtime_error("protected boot strap was mapped");
        });
    }
    if(repo) for(const auto* name:{"carrier","devkit_mini"}) s.run(std::string("real project ")+name,[&] {
        const auto snapshot=parse_json_file((fixtures/"som_real_baseline.json").string());
        auto live=live_from(field(snapshot,"zynq"));
        live.source=(*repo/"som/Zynq_SoM.kicad_sch").string();
        const auto loaded=load_devicetree_input(*repo,*repo/name,live);
        const auto out=generate_devicetree(loaded);
        same_text(out.text,native_expected(read(fixtures/("devicetree_"+std::string(name)+"_golden.dtsi")),
                  std::string(name)+"/som_mapping.json"));
        require(out.mio_rows.size()==7,"real SoM MIO count changed");
    });
    std::cout<<s.count<<" device-tree contracts passed\n";
}
}  // namespace

int main(int argc,char** argv) {
    try {
        require(argc==2 || argc==3,"usage: devicetree_contracts DATA_DIR [REPO_ROOT]");
        contracts(argv[1],argc==3 ? std::optional<fs::path>{argv[2]} : std::nullopt);
        return 0;
    }catch(const std::exception& e){std::cerr<<e.what()<<'\n';return 1;}
}
